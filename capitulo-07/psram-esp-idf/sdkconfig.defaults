## capitulo-28/anatomia-esp-idf/main/Kconfig.projbuild
```kconfig
menu "Anatomia (exemplo do livro)"

    config ANATOMIA_GPIO_LED
        int "GPIO do LED"
        range 0 54
        default 2
        help
            Pino em que o LED está ligado. Confira no esquema da placa.

    config ANATOMIA_PERIODO_MS
        int "Meio período do pisca (ms)"
        range 50 5000
        default 500

endmenu
```

## capitulo-29/particoes-esp-idf/sdkconfig.defaults
```kconfig
CONFIG_ESPTOOLPY_FLASHSIZE_4MB=y
CONFIG_PARTITION_TABLE_CUSTOM=y
CONFIG_PARTITION_TABLE_CUSTOM_FILENAME="partitions.csv"
CONFIG_APP_PROJECT_VER_FROM_CONFIG=y
CONFIG_APP_PROJECT_VER="1.2.0"
```

## capitulo-30/pane-esp-idf/main/Kconfig.projbuild
```kconfig
menu "Pane (exemplo do livro)"

    choice PANE_TIPO
        prompt "Falha a provocar"
        default PANE_PONTEIRO_NULO

        config PANE_PONTEIRO_NULO
            bool "Escrita por ponteiro nulo"
        config PANE_ESTOURO_PILHA
            bool "Estouro de pilha de uma tarefa"
        config PANE_WATCHDOG
            bool "Tarefa presa sem ceder a CPU"
        config PANE_ERROR_CHECK
            bool "ESP_ERROR_CHECK com erro"
    endchoice

endmenu
```

## capitulo-48/media-movel-esp-idf/components/filtro/Kconfig
```kconfig
menu "Filtro de média móvel"

    config FILTRO_JANELA
        int "Tamanho da janela (amostras)"
        range 2 64
        default 8
        help
            Quantas amostras entram na média. Janelas maiores suavizam mais
            e respondem mais devagar.

endmenu
```

## capitulo-54/no-thread-esp-idf/sdkconfig.defaults
```kconfig
CONFIG_OPENTHREAD_ENABLED=y
CONFIG_OPENTHREAD_BORDER_ROUTER=n
CONFIG_OPENTHREAD_CONSOLE_ENABLE=n
CONFIG_OPENTHREAD_TASK_SIZE=10240
CONFIG_ESP_MAIN_TASK_STACK_SIZE=6144
```

## capitulo-56/cliente-https-esp-idf/sdkconfig.defaults
```kconfig
CONFIG_EXAMPLE_WIFI_SSID="minha-rede"
CONFIG_EXAMPLE_WIFI_PASSWORD="minha-senha"
CONFIG_EXAMPLE_CONNECT_IPV6=n
CONFIG_ESP_MAIN_TASK_STACK_SIZE=8192
CONFIG_PARTITION_TABLE_SINGLE_APP_LARGE=y
```

## capitulo-56/mqtt-eco-esp-idf/sdkconfig.defaults
```kconfig
CONFIG_EXAMPLE_WIFI_SSID="minha-rede"
CONFIG_EXAMPLE_WIFI_PASSWORD="minha-senha"
CONFIG_EXAMPLE_CONNECT_IPV6=n
```

## capitulo-59/wifi-economia-esp-idf/sdkconfig.defaults
```kconfig
CONFIG_PM_ENABLE=y
CONFIG_FREERTOS_USE_TICKLESS_IDLE=y
CONFIG_FREERTOS_HZ=1000
CONFIG_PM_SLP_IRAM_OPT=y
CONFIG_PM_RTOS_IDLE_OPT=y
CONFIG_ESP_WIFI_SLP_IRAM_OPT=y
CONFIG_PM_PROFILING=y
```

## capitulo-66/ota-eco-esp-idf/main/Kconfig.projbuild
```kconfig
menu "Exemplo OTA"
    config OTA_URL
        string "Endereço do firmware novo"
        default "https://exemplo.com.br/firmware/ota_eco.bin"
endmenu
```

## capitulo-68/painel-lvgl-esp-idf/main/Kconfig.projbuild
```kconfig
menu "Painel do exemplo"
    choice PAINEL
        prompt "Painel"
        default PAINEL_ST7789
        config PAINEL_ST7789
            bool "ST7789 240x320 por SPI"
        config PAINEL_QEMU
            bool "Painel RGB virtual do QEMU"
    endchoice
    config PINO_SCLK
        int "SCLK"
        default 18 if IDF_TARGET_ESP32
        default 6
    config PINO_MOSI
        int "MOSI"
        default 23 if IDF_TARGET_ESP32
        default 7
    config PINO_CS
        int "CS"
        default 5 if IDF_TARGET_ESP32
        default 10
    config PINO_DC
        int "DC"
        default 16 if IDF_TARGET_ESP32
        default 4
    config PINO_RST
        int "RST"
        default 17 if IDF_TARGET_ESP32
        default 5
endmenu
```
